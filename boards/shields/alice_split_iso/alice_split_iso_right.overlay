#include "alice_split_iso.dtsi"

/ {
    kscan0: kscan0 {
        compatible = "zmk,kscan-gpio-matrix";
        diode-direction = "col2row";
        wakeup-source;

        col-gpios =
            <&pro_micro 1 GPIO_ACTIVE_HIGH>,   // COL0 - P0.06
            <&pro_micro 0 GPIO_ACTIVE_HIGH>,   // COL1 - P0.08
            <&pro_micro 2 GPIO_ACTIVE_HIGH>,   // COL2 - P0.17
            <&pro_micro 3 GPIO_ACTIVE_HIGH>,   // COL3 - P0.20
            <&pro_micro 20 GPIO_ACTIVE_HIGH>,  // COL4 - P0.29
            <&pro_micro 19 GPIO_ACTIVE_HIGH>,  // COL5 - P0.02
            <&pro_micro 14 GPIO_ACTIVE_HIGH>,  // COL6 - P1.11
            <&pro_micro 15 GPIO_ACTIVE_HIGH>;  // COL7 - P1.13

        row-gpios =
            <&pro_micro 21 (GPIO_ACTIVE_HIGH | GPIO_PULL_DOWN)>, // ROW0 - P0.31
            <&pro_micro 4  (GPIO_ACTIVE_HIGH | GPIO_PULL_DOWN)>, // ROW1 - P0.22
            <&pro_micro 5  (GPIO_ACTIVE_HIGH | GPIO_PULL_DOWN)>, // ROW2 - P0.24
            <&pro_micro 10 (GPIO_ACTIVE_HIGH | GPIO_PULL_DOWN)>, // ROW3 - P0.09
            <&pro_micro 16 (GPIO_ACTIVE_HIGH | GPIO_PULL_DOWN)>; // ROW4 - P0.10
    };
};

&matrix_transform0 {
    col-offset = <9>;
};

&physical_layout_alice_split_iso {
    kscan = <&kscan0>;
};
