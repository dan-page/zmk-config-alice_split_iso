## boards/shields/alice_split_iso/Kconfig.defconfig
```kconfig
if SHIELD_ALICE_SPLIT_ISO_LEFT

# Name must be less than 16 characters long!
config ZMK_KEYBOARD_NAME
    default "alice_split_iso"

config ZMK_SPLIT_ROLE_CENTRAL
    default y

config ZMK_SPLIT_BLE_CENTRAL_PERIPHERALS
  default 1

config BT_MAX_CONN
  default 6

config BT_MAX_PAIRED
  default 6

endif

if SHIELD_ALICE_SPLIT_ISO_LEFT || SHIELD_ALICE_SPLIT_ISO_RIGHT

config ZMK_SPLIT
    default y

endif
```

## boards/shields/alice_split_iso/Kconfig.shield
```kconfig
config SHIELD_ALICE_SPLIT_ISO_LEFT
    def_bool $(shields_list_contains,alice_split_iso_left)
  
config SHIELD_ALICE_SPLIT_ISO_RIGHT
    def_bool $(shields_list_contains,alice_split_iso_right)
  
```
